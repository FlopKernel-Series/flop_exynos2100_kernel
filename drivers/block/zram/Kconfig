## drivers/block/zram/Kconfig
```kconfig
# SPDX-License-Identifier: GPL-2.0
config ZRAM
	tristate "Compressed RAM block device support"
	depends on BLOCK && SYSFS && MMU
	select ZSMALLOC
	default n
	help
	  Creates virtual block devices called /dev/zramX (X = 0, 1, ...).
	  Pages written to these disks are compressed and stored in memory
	  itself. These disks allow very fast I/O and compression provides
	  good amounts of memory savings.

	  It has several use cases, for example: /tmp storage, use as swap
	  disks and maybe many more.

	  See Documentation/admin-guide/blockdev/zram.rst for more information.

config ZRAM_BACKEND_LZ4
	bool "lz4 compression support"
	depends on ZRAM
	select LZ4_COMPRESS
	select LZ4_DECOMPRESS

config ZRAM_BACKEND_LZ4HC
	bool "lz4hc compression support"
	depends on ZRAM
	select LZ4HC_COMPRESS
	select LZ4_DECOMPRESS

config ZRAM_BACKEND_ZSTD
	bool "zstd compression support"
	depends on ZRAM
	select ZSTD_COMPRESS
	select ZSTD_DECOMPRESS

config ZRAM_BACKEND_DEFLATE
	bool "deflate compression support"
	depends on ZRAM
	select ZLIB_DEFLATE
	select ZLIB_INFLATE

config ZRAM_BACKEND_842
	bool "842 compression support"
	depends on ZRAM
	select 842_COMPRESS
	select 842_DECOMPRESS

config ZRAM_BACKEND_LZ4K
	bool "lz4k compression support"
	depends on ZRAM
	select LZ4K_COMPRESS
	select LZ4K_DECOMPRESS

config ZRAM_BACKEND_LZ4KD
	bool "lz4kd compression support"
	depends on ZRAM
	select LZ4KD_COMPRESS
	select LZ4KD_DECOMPRESS

config ZRAM_BACKEND_FORCE_LZO
	depends on ZRAM
	def_bool !ZRAM_BACKEND_LZ4 && !ZRAM_BACKEND_LZ4HC && \
		!ZRAM_BACKEND_ZSTD && !ZRAM_BACKEND_DEFLATE && \
		!ZRAM_BACKEND_842 && !ZRAM_BACKEND_LZ4K && \
		!ZRAM_BACKEND_LZ4KD

config ZRAM_BACKEND_LZO
	bool "lzo and lzo-rle compression support" if !ZRAM_BACKEND_FORCE_LZO
	depends on ZRAM
	default ZRAM_BACKEND_FORCE_LZO
	select LZO_COMPRESS
	select LZO_DECOMPRESS

choice
	prompt "Default zram compressor"
	default ZRAM_DEF_COMP_LZORLE
	depends on ZRAM

config ZRAM_DEF_COMP_LZORLE
	bool "lzo-rle"
	depends on ZRAM_BACKEND_LZO

config ZRAM_DEF_COMP_LZO
	bool "lzo"
	depends on ZRAM_BACKEND_LZO

config ZRAM_DEF_COMP_LZ4
	bool "lz4"
	depends on ZRAM_BACKEND_LZ4

config ZRAM_DEF_COMP_LZ4HC
	bool "lz4hc"
	depends on ZRAM_BACKEND_LZ4HC

config ZRAM_DEF_COMP_ZSTD
	bool "zstd"
	depends on ZRAM_BACKEND_ZSTD

config ZRAM_DEF_COMP_DEFLATE
	bool "deflate"
	depends on ZRAM_BACKEND_DEFLATE

config ZRAM_DEF_COMP_842
	bool "842"
	depends on ZRAM_BACKEND_842

config ZRAM_DEF_COMP_LZ4K
	bool "lz4k"
	depends on ZRAM_BACKEND_LZ4K

config ZRAM_DEF_COMP_LZ4KD
	bool "lz4kd"
	depends on ZRAM_BACKEND_LZ4KD

endchoice

config ZRAM_DEF_COMP
	string
	depends on ZRAM
	default "lzo-rle" if ZRAM_DEF_COMP_LZORLE
	default "lzo" if ZRAM_DEF_COMP_LZO
	default "lz4" if ZRAM_DEF_COMP_LZ4
	default "lz4hc" if ZRAM_DEF_COMP_LZ4HC
	default "zstd" if ZRAM_DEF_COMP_ZSTD
	default "deflate" if ZRAM_DEF_COMP_DEFLATE
	default "842" if ZRAM_DEF_COMP_842
	default "lz4k" if ZRAM_DEF_COMP_LZ4K
	default "lz4kd" if ZRAM_DEF_COMP_LZ4KD
	default "unset-value"

config ZRAM_WRITEBACK
       bool "Write back incompressible or idle page to backing device"
       depends on ZRAM
       default y
       help
	 With incompressible page, there is no memory saving to keep it
	 in memory. Instead, write it out to backing device.
	 For this feature, admin should set up backing device via
	 /sys/block/zramX/backing_dev.

	 With /sys/block/zramX/{idle,writeback}, application could ask
	 idle page's writeback to the backing device to save in memory.

	 See Documentation/admin-guide/blockdev/zram.rst for more information.

config ZRAM_MEMORY_TRACKING
	bool "Track zRam block status"
	depends on ZRAM && DEBUG_FS
	help
	  With this feature, admin can track the state of allocated blocks
	  of zRAM. Admin could see the information via
	  /sys/kernel/debug/zram/zramX/block_state.

	  See Documentation/admin-guide/blockdev/zram.rst for more information.

config ZRAM_LRU_WRITEBACK
	bool "ZRAM LRU-based writeback"
	depends on ZRAM_WRITEBACK
	help
	  This feature supports zram lru-based writeback (SQZR).

config ZRAM_LRU_WRITEBACK_LIMIT
	int "Limit zram lru writeback"
	default 5120
	depends on ZRAM_LRU_WRITEBACK

config ZRAM_SIZE_AUTO
	bool "Auto-detect zram size based on RAM"
	default n
	depends on ZRAM
	help
	  Automatically sets zram size based on total system memory.
	  6GB RAM -> 3GB zram
	  8GB RAM -> 4GB zram
	  12GB RAM -> 6GB zram
	  16GB RAM -> 8GB zram
	  Unknown RAM sizes fall back to rounded 50%% sizing.

config ZRAM_SIZE_OVERRIDE
	int "zram size to set from kernel"
	depends on !ZRAM_SIZE_AUTO
	range 1 8589934592
	default 3221225472

config ZRAM_DEFAULT_COMP_ALGORITHM
	string "Default ZRAM algorithm"
	default "lzo-rle"

config ZRAM_MULTI_COMP
	bool "Enable multiple compression streams"
	depends on ZRAM
	help
	  This will enable multi-compression streams, so that ZRAM can
	  re-compress pages using a potentially slower but more effective
	  compression algorithm. Note, that IDLE page recompression
	  requires ZRAM_MEMORY_TRACKING.

config ZRAM_DEFAULT_SECONDARY_COMP_ALGORITHM
	string "Default secondary ZRAM algorithm"
	depends on ZRAM_MULTI_COMP
	default "zstd" if ZRAM_BACKEND_ZSTD
	default ZRAM_DEFAULT_COMP_ALGORITHM
```

## drivers/net/wireless/realtek/rtl8xxxu-a5a5aa555oo/Kconfig
```kconfig
# SPDX-License-Identifier: GPL-2.0-only
#
# RTL8XXXU Wireless LAN device configuration
#

config RTL8XXXU
	tristate "RTL8723AU/RTL8188[EF]U/RTL819[12][CEF]U/RTL8710BU (mac80211) support"
	depends on MAC80211 && USB
	---help---
	  This enables the a5a5aa555oo rtl8xxxu out-of-tree driver in in-tree
	  Kconfig/Kbuild mode.

	  The module will be called rtl8xxxu_git.

config RTL8XXXU_UNTESTED
	bool "Include support for untested Realtek 8xxx USB devices (EXPERIMENTAL)"
	depends on RTL8XXXU
	---help---
	  This option enables detection of additional Realtek 8xxx USB devices
	  gated behind CONFIG_RTL8XXXU_UNTESTED in the driver sources.
```

## drivers/net/wireless/realtek/rtw88-lwfinger/Kconfig
```kconfig
# SPDX-License-Identifier: GPL-2.0-only

menuconfig RTW88
	tristate "Realtek rtw88 backport support"
	depends on MAC80211
	help
	  This enables the lwfinger backport of Realtek rtw88 drivers.

if RTW88

config RTW88_CORE
	tristate
	select WANT_DEV_COREDUMP

config RTW88_USB
	tristate
	depends on USB

config RTW88_8821C
	tristate

config RTW88_8822B
	tristate

config RTW88_8822C
	tristate

config RTW88_8821CU
	tristate "Realtek 8821CU USB wireless network adapter"
	depends on USB
	select RTW88_CORE
	select RTW88_USB
	select RTW88_8821C

config RTW88_8822BU
	tristate "Realtek 8822BU USB wireless network adapter"
	depends on USB
	select RTW88_CORE
	select RTW88_USB
	select RTW88_8822B

config RTW88_8822CU
	tristate "Realtek 8822CU USB wireless network adapter"
	depends on USB
	select RTW88_CORE
	select RTW88_USB
	select RTW88_8822C

config RTW88_LEDS
	bool "Realtek rtw88 LED support"
	depends on RTW88_CORE
	depends on LEDS_CLASS
	default y

config RTW88_DEBUG
	bool "Realtek rtw88 debug support"
	depends on RTW88_CORE
	default n

config RTW88_DEBUGFS
	bool "Realtek rtw88 debugfs support"
	depends on RTW88_CORE && DEBUG_FS
	default n

endif
```

## drivers/optics/Kconfig
```kconfig
config SENSORS_FLICKER_SELF_TEST
	tristate "Flicker EOL test use flash"
	help
		make Test environment using led flash.

config SENSORS_STK3A8X
    tristate "sensortek stk3a8x light device driver"
    depends on I2C
    help
        If you say yes here, you get support for the stk3a8x.

config SENSORS_TSL2510
	tristate "AMS TSL2510 MoBeam, RemCon, ALS, Proximity, Flicker sensor"
	depends on I2C && SYSFS
	help
	  If you say yes here you get support for the AMS TSL2510
	  mobeam, ambient light, proximity, and flicker sensors.

	  This driver can also be built as a module.  If so, the module
	  will be called TSL2510.
```
