## drivers/staging/kshrink_lruvecd/Kconfig
```kconfig
config KSHRINK_LRUVECD
	bool "Allow asynchronous shrink lruvec reclaim"
	depends on MMU
	select PAGE_EXTENSION
	default n
	help
	  Asynchronous lruvec reclaim helper.
```

## drivers/staging/kshrink_slabd/Kconfig
```kconfig
config KSHRINK_SLABD
	bool "Allow asynchronous shrink slab"
	default n
	help
	  Asynchronous shrink slab reclaim helper.
```
